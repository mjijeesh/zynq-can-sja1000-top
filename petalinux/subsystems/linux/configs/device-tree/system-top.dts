/dts-v1/;
/include/ "system-conf.dtsi"
/ {
};

&sja1000_0 {
	compatible = "nxp,sja1000";
	nxp,external-clock-frequency = <100000000>;
	interrupt-parent = <&intc>;
	interrupts = <0 29 4>;
	reg-io-width = <4>;
};

&sja1000_1 {
	compatible = "nxp,sja1000";
	nxp,external-clock-frequency = <100000000>;
	interrupt-parent = <&intc>;
	interrupts = <0 30 4>;
	reg-io-width = <4>;
};
