/*
 * CAUTION: This file is automatically generated by Xilinx.
 * Version: HSI 2015.4
 * Today is: Wed May 11 12:26:12 2016
*/


/ {
	amba_pl: amba_pl {
		#address-cells = <1>;
		#size-cells = <1>;
		compatible = "simple-bus";
		ranges ;
		sja1000_0: sja1000@43c00000 {
			compatible = "xlnx,sja1000-1.0";
			reg = <0x43c00000 0x10000>;
			xlnx,s00-axi-addr-width = <0x8>;
			xlnx,s00-axi-data-width = <0x20>;
		};
	};
};
