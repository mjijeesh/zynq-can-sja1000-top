## petalinux/bootscript.its
```
/dts-v1/;

/ {
	description = "bootscript";
	#address-cells = <1>;

	images {
		bootscript@1 {
			description = "Bootscript";
			data = /incbin/("./bootscript.txt");
			type = "script";
			compression = "none";
			hash@1 {
				algo = "crc32";
			};
		};
	};
};
```

## petalinux/uboot-image.its
```
/*
 * Simple U-boot uImage source file containing a single kernel and FDT blob
 */

/dts-v1/;

/ {
	description = "Kernel for MicroZed";
	#address-cells = <1>;

	images {
		kernel@1 {
			description = "Linux kernel";
			data = /incbin/("./images/linux/zImage");
			type = "kernel";
			arch = "arm";
			os = "linux";
			compression = "none";
			load = <0x00008000>;
			entry = <0x00008000>;
			hash@1 {
				algo = "crc32";
			};
			hash@2 {
				algo = "sha1";
			};
		};
		fdt@1 {
			description = "Flattened Device Tree blob";
			data = /incbin/("./images/linux/system.dtb");
			type = "flat_dt";
			arch = "arm";
			compression = "none";
			hash@1 {
				algo = "crc32";
			};
			hash@2 {
				algo = "sha1";
			};
		};
		fpga@1 {
			description = "FPGA bitstream";
			data = /incbin/("./images/linux/system.bit.gz");
			type = "filesystem";
			compression = "gzip";
			hash@1 {
				algo = "crc32";
			};
			hash@2 {
				algo = "sha1";
			};
		};
	};

	configurations {
		default = "conf@1";
		conf@1 {
			description = "Boot Linux kernel with FDT blob";
			kernel = "kernel@1";
			fdt = "fdt@1";
		};
	};
};
```
