// Device Tree Example: Full Reconfiguration without Bridges
/dts-v1/;
/plugin/;

/ {
    fragment@0 {
        target-path = "/fpga-full";
//        #address-cells = <1>;
//        #size-cells = <1>;

        __overlay__ {
            #address-cells = <1>;
            #size-cells = <1>;

            firmware-name = "system.bit.bin";
        };
    };
};
